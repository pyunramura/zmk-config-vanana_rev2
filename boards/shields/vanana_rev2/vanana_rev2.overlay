#include "vanana_rev2.dtsi"

/ {
    kscan0: kscan0 {
        compatible = "zmk,kscan-gpio-matrix";
        diode-direction = "col2row";
        wakeup-source;

		row-gpios 
		    = <&gpio0 17 (GPIO_ACTIVE_HIGH | GPIO_PULL_DOWN)> 
			, <&gpio0 24 (GPIO_ACTIVE_HIGH | GPIO_PULL_DOWN)>
			, <&gpio0 11 (GPIO_ACTIVE_HIGH | GPIO_PULL_DOWN)>
			, <&gpio1 4 (GPIO_ACTIVE_HIGH | GPIO_PULL_DOWN)>
      		, <&gpio1 6 (GPIO_ACTIVE_HIGH | GPIO_PULL_DOWN)>
      		, <&gpio0 29 (GPIO_ACTIVE_HIGH | GPIO_PULL_DOWN)>
			;

        col-gpios
		    = <&gpio1 11 GPIO_ACTIVE_HIGH>
    		, <&gpio1 13 GPIO_ACTIVE_HIGH>
			, <&gpio1 15 GPIO_ACTIVE_HIGH>
			, <&gpio0 2 GPIO_ACTIVE_HIGH>
			, <&gpio0 31 GPIO_ACTIVE_HIGH>
			, <&gpio0 8 GPIO_ACTIVE_HIGH>
			, <&gpio0 6 GPIO_ACTIVE_HIGH>
			, <&gpio0 20 GPIO_ACTIVE_HIGH>
			, <&gpio0 22 GPIO_ACTIVE_HIGH>
			, <&gpio1 0 GPIO_ACTIVE_HIGH>
		    ;
 
    };
};

&physical_layout_vanana_rev2 {
    kscan = <&kscan0>;
};
&encoder0 {
    a-gpios = <&gpio0 9 (GPIO_ACTIVE_HIGH | GPIO_PULL_UP)>;
    b-gpios = <&gpio0 10 (GPIO_ACTIVE_HIGH | GPIO_PULL_UP)>;
    status = "okay";
};
